## components/mcc_capture/Kconfig.projbuild
```kconfig
menu "MCC Capture Configuration"

    if IDF_TARGET_ESP32S3

        config ANALYZER_PCLK_PIN
            int "GPIO NUM for PCLK"
            range -1 48
            default 40
            help
                RSP32S3 requires 1 free gpio to form a PCLK

        config ANALYZER_USE_LEDC_TIMER_FOR_PCLK
            bool "Use ledc timer for PCLK < 1 mHz"
            default n
            help
                for PCLK from 1 mHz to 80 mHz, an internal divider  is used, if PCLK are needed less, we use a separate channel LEDC_PWM

        if ANALYZER_USE_LEDC_TIMER_FOR_PCLK

            config ANALYZER_LEDC_TIMER_NUMBER
                int "LEDC_TIMER_NUMBER for PCLK"
                range 0 3
                default 3

            config ANALYZER_LEDC_CHANNEL_NUMBER
                int "LEDC_CHANNEL_NUMBER for PCLK"
                range 0 7
                default 7
        endif
    endif


endmenu
```
